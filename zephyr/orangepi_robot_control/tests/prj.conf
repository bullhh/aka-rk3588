## CMakeLists.txt
```
# SPDX-License-Identifier: Apache-2.0

cmake_minimum_required(VERSION 3.20.0)
find_package(Zephyr REQUIRED HINTS $ENV{ZEPHYR_BASE})
project(orangepi_robot_control_tests)

set(ROBOT_APP_DIR ${CMAKE_CURRENT_LIST_DIR}/..)

target_include_directories(app PRIVATE
  ${ROBOT_APP_DIR}/src
  ${ROBOT_APP_DIR}/../../protocol
)
target_sources(app PRIVATE
  src/main.c
  ${ROBOT_APP_DIR}/src/robot_controller.c
  ${ROBOT_APP_DIR}/src/robot_config_receiver.c
  ${ROBOT_APP_DIR}/src/resettable_watchdog.c
)
```

## prj.conf
```kconfig
CONFIG_ZTEST=y
CONFIG_MAIN_STACK_SIZE=4096
CONFIG_SYSTEM_WORKQUEUE_STACK_SIZE=2048
```

## src/main.c
```c
/* SPDX-License-Identifier: Apache-2.0 */

#include "feetech_bus.h"
#include "perception_result_v2.h"
#include "resettable_watchdog.h"
#include "robot_config_receiver.h"
#include "robot_controller.h"

#include <zephyr/kernel.h>
#include <zephyr/ztest.h>

#include <errno.h>
#include <string.h>

static struct feetech_bus fake_bus;
static int wheel_commands;
static int arm_commands;
static int16_t last_left;
static int16_t last_right;
static uint16_t last_arm_pose[FEETECH_ARM_COUNT];
static bool fail_final_stop;
static int wheel_fault;
static int wheel_reads;
static bool saw_wheel_motion;
static uint16_t wheel_positions[3];

int feetech_read_wheel_feedback(struct feetech_bus *bus, uint8_t index,
                                int16_t *velocity, uint16_t *position)
{
    zassert_equal(bus, &fake_bus);
    zassert_true(index < 3);
    ++wheel_reads;
    if (wheel_fault == 4) return -ETIMEDOUT;
    *velocity = (last_right - last_left) * 10;
    if (wheel_fault == 1 && index == 1) *velocity = 0;
    if (wheel_fault == 2 && index == 2) *velocity = -*velocity;
    if (wheel_fault == 3 && saw_wheel_motion && *velocity == 0) *velocity = 100;
    /* Fault 7 reports speed while the encoder remains frozen. */
    if (wheel_fault != 7) {
        wheel_positions[index] = (wheel_positions[index] + *velocity / 10) & 0x0fff;
    }
    if (last_left == 0 && last_right == 0) {
        if (wheel_fault == 5) {
            /* Stationary one-count quantization with signed speed noise. */
            *velocity = (wheel_reads & 1) ? 50 : -50;
            wheel_positions[index] = 1000 + ((wheel_reads / 3) & 1);
        } else if (wheel_fault == 6) {
            /* One count per sample still accumulates into real creeping. */
            *velocity = 0;
            wheel_positions[index] = (wheel_positions[index] + 1) & 0x0fff;
        }
    }
    *position = wheel_positions[index];
    return 0;
}

static struct robot_runtime_config_v1 test_runtime_config(void)
{
	struct robot_runtime_config_v1 config = {
		.magic = ROBOT_RUNTIME_CONFIG_MAGIC,
		.version = ROBOT_RUNTIME_CONFIG_VERSION,
		.size = sizeof(config),
		.ball_center_tolerance = 30U,
		.ball_target_size = 155U,
		.ball_size_tolerance = 5U,
		.ball_stable_frames = 2U,
		.bucket_center_tolerance = 20U,
		.bucket_target_size = 380U,
		.bucket_size_tolerance = 15U,
		.bucket_stable_frames = 3U,
		.ball_search_speed = 35U,
		.ball_far_speed = 65U,
		.ball_near_speed = 20U,
		.ball_reverse_speed = 25U,
		.ball_turn_speed = 15U,
		.bucket_search_speed = 18U,
		.bucket_far_speed = 70U,
		.bucket_near_speed = 25U,
		.bucket_reverse_speed = 25U,
		.bucket_turn_speed = 18U,
		.motion_speed_level = 4U,
		.gripper_range_min = 1257U,
		.gripper_range_max = 2731U,
		.gripper_hold_percent = 25U,
	};
	for (size_t pose = 0; pose < ROBOT_POSE_COUNT; ++pose) {
		for (size_t joint = 0; joint < ROBOT_JOINT_COUNT; ++joint) {
			config.poses[pose][joint] = joint == 5U ? 1404U : 2048U;
		}
	}
	return config;
}

int feetech_send_diff_drive(struct feetech_bus *bus, int16_t left,
			    int16_t right, const char *label)
{
	zassert_equal(bus, &fake_bus);
	zassert_not_null(label);
	++wheel_commands;
	last_left = left;
	last_right = right;
	saw_wheel_motion |= left != 0 || right != 0;
	if (fail_final_stop && strcmp(label, "ROBOT_CI_COMPLETE_STOP") == 0) {
		return -EIO;
	}
	return 0;
}

void feetech_stop_wheels(struct feetech_bus *bus, const char *label)
{
	(void)feetech_send_diff_drive(bus, 0, 0, label);
}

int feetech_send_arm_pose(struct feetech_bus *bus,
			 const uint16_t positions[FEETECH_ARM_COUNT])
{
	zassert_equal(bus, &fake_bus);
	++arm_commands;
	memcpy(last_arm_pose, positions, sizeof(last_arm_pose));
	return 0;
}

int feetech_read_arm(struct feetech_bus *bus,
		     uint16_t positions[FEETECH_ARM_COUNT],
		     uint8_t *gripper_status)
{
	zassert_equal(bus, &fake_bus);
	memcpy(positions, last_arm_pose, sizeof(last_arm_pose));
	*gripper_status = 0U;
	return 0;
}

static void reset_fakes(void)
{
	wheel_commands = 0;
	wheel_fault = 0;
    for (int i = 0; i < 3; ++i) wheel_positions[i] = 1000;
    wheel_positions[0] = 4036; /* Exercise encoder wrap during forward motion. */
	wheel_reads = 0;
	saw_wheel_motion = false;
	arm_commands = 0;
	fail_final_stop = false;
	last_left = 0;
	last_right = 0;
	memset(last_arm_pose, 0, sizeof(last_arm_pose));
}

static struct perception_result_v2 visible_ball(uint16_t center_x,
						 uint16_t box_size)
{
	return (struct perception_result_v2) {
		.magic = PERCEPTION_MAGIC,
		.version = PERCEPTION_VERSION,
		.flags = PERCEPTION_TARGET_VISIBLE,
		.frame_width = 640U,
		.frame_height = 480U,
		.center_x = center_x,
		.center_y = 240U,
		.box_width = box_size,
		.box_height = box_size,
	};
}

static void finish_wheel_checks(struct robot_controller *controller)
{
    for (int64_t now = 150; now <= 12000 && controller->state == ROBOT_STATE_CI_WHEELS;
         now += 50) {
        int before = wheel_reads;
        robot_controller_arm_tick(controller, now);
        zassert_true(wheel_reads - before <= 1, "multiple UART reads in one tick");
    }
}

ZTEST(robot_control, test_wheels_require_all_feedback_and_final_stop)
{
    for (int failure = 0; failure <= 7; ++failure) {
        struct robot_controller controller = {
            .bus = &fake_bus, .state = ROBOT_STATE_PLACE_CLOSE,
            .robot_ci_mode = true,
            .motion = {.active = true, .duration_ms = 100U},
        };
        reset_fakes();
        wheel_fault = failure;
        controller.config = test_runtime_config();
        robot_controller_arm_tick(&controller, 100);
        finish_wheel_checks(&controller);
        const bool should_pass = failure == 0 || failure == 5;
        zexpect_equal(controller.state, should_pass ? ROBOT_STATE_TEST_COMPLETE : ROBOT_STATE_FAULT,
                      "feedback scenario %d", failure);
        zassert_equal(last_left, 0);
        zassert_equal(last_right, 0);
        if (should_pass) zexpect_equal(controller.ci_checks, ROBOT_CONTROL_CHECKS_REQUIRED);
        else {
            zexpect_not_equal(controller.ci_checks, ROBOT_CONTROL_CHECKS_REQUIRED);
            int saved_error = controller.fault_code;
            wheel_fault = 0;
            robot_controller_arm_tick(&controller, 15000);
            zassert_equal(controller.fault_code, saved_error);
            zexpect_equal(controller.state, ROBOT_STATE_FAULT);
        }
    }
}

ZTEST(robot_control, test_ci_watchdog_failure_is_sticky)
{
    struct robot_controller controller = {
        .bus = &fake_bus, .state = ROBOT_STATE_CI_WHEELS,
        .robot_ci_mode = true, .have_input = true, .last_input_ms = 100,
    };
    reset_fakes();
    controller.config = test_runtime_config();
    zassert_true(robot_controller_input_timeout(&controller, 450));
    struct perception_result_v2 result = visible_ball(100, 50);
    robot_controller_process_perception(&controller, &result, 451);
    robot_controller_arm_tick(&controller, 500);
    zassert_equal(controller.state, ROBOT_STATE_FAULT);
    zassert_equal(controller.fault_code, -ETIMEDOUT);
    zassert_equal(last_left, 0);
    zassert_equal(last_right, 0);
}

ZTEST(robot_control, test_command_only_completion_is_not_hardware_acceptance)
{
    struct robot_controller controller = {
        .bus = &fake_bus, .state = ROBOT_STATE_PLACE_CLOSE,
        .robot_ci_mode = true,
        .motion = {.active = true, .duration_ms = 100U},
    };
    reset_fakes();
    controller.config = test_runtime_config();
    robot_controller_arm_tick(&controller, 100);
    zassert_not_equal(controller.state, ROBOT_STATE_TEST_COMPLETE,
                     "stop writes alone cannot prove wheel feedback");
}

ZTEST(robot_control, test_failed_final_stop_cannot_publish_test_complete)
{
	struct robot_controller controller = {
		.bus = &fake_bus,
		.state = ROBOT_STATE_PLACE_CLOSE,
		.robot_ci_mode = true,
		.motion = {.active = true, .duration_ms = 100U},
	};
	reset_fakes();
	controller.config = test_runtime_config();
	fail_final_stop = true;
	robot_controller_arm_tick(&controller, 100);
	zassert_equal(controller.state, ROBOT_STATE_FAULT);
	zassert_equal(controller.completed_cycles, 0);
}

ZTEST(robot_control, test_control_result_is_session_bound_idempotent_and_resettable)
{
	struct robot_controller controller = {
		.bus = &fake_bus, .state = ROBOT_STATE_PLACE_CLOSE,
		.robot_ci_mode = true,
		.motion = {.active = true, .duration_ms = 100U},
	};
	struct robot_config_message_v1 request = {
		.magic = ROBOT_CONFIG_MESSAGE_MAGIC, .version = ROBOT_CONFIG_MESSAGE_VERSION,
		.type = ROBOT_CONTROL_FINISH, .session_id = 17, .config_crc32 = 123,
	};
	struct robot_config_message_v1 first, second;
	reset_fakes();
	controller.config = test_runtime_config();
	robot_controller_control_result(&controller, 17, 123, &request, &first);
	zassert_equal(first.status, ROBOT_CONTROL_STATUS_PENDING);
	robot_controller_arm_tick(&controller, 100);
	finish_wheel_checks(&controller);
	robot_controller_control_result(&controller, 17, 123, &request, &first);
	zassert_equal(first.status, ROBOT_CONFIG_STATUS_OK);
	int commands_before = wheel_commands + arm_commands;
	robot_controller_control_result(&controller, 17, 123, &request, &second);
	zassert_mem_equal(&first, &second, sizeof(first));
	zassert_equal(wheel_commands + arm_commands, commands_before);
	request.session_id = 16;
	robot_controller_control_result(&controller, 17, 123, &request, &first);
	zassert_equal(first.status, ROBOT_CONFIG_STATUS_WRONG_SESSION);
	request.session_id = 17;
	zassert_ok(robot_controller_apply_config(&controller, &controller.config));
	zassert_equal(controller.completed_cycles, 0);
	robot_controller_control_result(&controller, 17, 123, &request, &first);
	zassert_equal(first.status, ROBOT_CONTROL_STATUS_PENDING);
	controller.state = ROBOT_STATE_FAULT;
	robot_controller_control_result(&controller, 17, 123, &request, &first);
	zassert_equal(first.status, ROBOT_CONTROL_STATUS_FAILED);
}

ZTEST(robot_control, test_perception_drives_chassis_without_arm_tick)
{
	struct robot_controller controller = {
		.bus = &fake_bus,
		.state = ROBOT_STATE_SEARCH_BALL,
		.last_ball_side = 1,
	};
	controller.config = test_runtime_config();
	struct perception_result_v2 result = visible_ball(100U, 50U);

	reset_fakes();
	robot_controller_process_perception(&controller, &result, 1000);
	zassert_equal(wheel_commands, 1);
	zassert_equal(last_left, -15);
	zassert_equal(last_right, 15);
	zassert_equal(arm_commands, 0);

	result.center_x = 540U;
	robot_controller_process_perception(&controller, &result, 1010);
	zassert_equal(wheel_commands, 2);
	zassert_equal(last_left, 15);
	zassert_equal(last_right, -15);
}

ZTEST(robot_control, test_arm_tick_only_advances_interpolation)
{
	struct robot_controller controller = {
		.bus = &fake_bus,
		.state = ROBOT_STATE_PICK_HOME,
		.motion = {
			.started_ms = 0,
			.duration_ms = 100U,
			.active = true,
		},
	};
	controller.config = test_runtime_config();
	struct perception_result_v2 result = visible_ball(100U, 50U);

	reset_fakes();
	for (size_t index = 0; index < FEETECH_ARM_COUNT; ++index) {
		controller.motion.start[index] = 1000U;
		controller.motion.target[index] = 2000U;
	}

	robot_controller_process_perception(&controller, &result, 40);
	zassert_equal(wheel_commands, 0);
	zassert_equal(arm_commands, 0);

	robot_controller_arm_tick(&controller, 50);
	zassert_equal(arm_commands, 1);
	zassert_equal(last_arm_pose[0], 1500U);
	zassert_equal(wheel_commands, 0);
}

ZTEST(robot_control, test_input_timeout_stops_once_and_new_input_recovers)
{
	struct robot_controller controller = {
		.bus = &fake_bus,
		.state = ROBOT_STATE_SEARCH_BALL,
		.last_ball_side = 1,
	};
	controller.config = test_runtime_config();
	struct perception_result_v2 result = visible_ball(320U, 50U);

	reset_fakes();
	robot_controller_process_perception(&controller, &result, 1000);
	zassert_equal(last_left, 65);
	zassert_equal(last_right, 65);
	zassert_false(robot_controller_input_timeout(
		&controller, 1000 + ROBOT_INPUT_TIMEOUT_MS - 1U));
	zassert_equal(wheel_commands, 1);

	zassert_true(robot_controller_input_timeout(
		&controller, 1000 + ROBOT_INPUT_TIMEOUT_MS));
	zassert_equal(wheel_commands, 2);
	zassert_equal(last_left, 0);
	zassert_equal(last_right, 0);
	zassert_false(robot_controller_input_timeout(&controller, 2000));
	zassert_equal(wheel_commands, 2);

	robot_controller_process_perception(&controller, &result, 2001);
	zassert_equal(wheel_commands, 3);
	zassert_equal(last_left, 65);
	zassert_equal(last_right, 65);
}

ZTEST(robot_control, test_config_update_accepts_idle_bucket_search)
{
	struct robot_controller controller = {
		.bus = &fake_bus,
		.state = ROBOT_STATE_SEARCH_BUCKET,
		.stable_frames = 3U,
		.have_input = true,
	};
	controller.config = test_runtime_config();

	reset_fakes();
	controller.motion.active = true;
	zassert_false(robot_controller_prepare_config_update(&controller));
	zassert_equal(wheel_commands, 0);

	controller.motion.active = false;
	zassert_true(robot_controller_prepare_config_update(&controller));
	zassert_equal(wheel_commands, 1);
	zassert_equal(last_left, 0);
	zassert_equal(last_right, 0);
	zassert_equal(controller.stable_frames, 0U);
	zassert_false(controller.have_input);
}

static K_SEM_DEFINE(watchdog_fired, 0, 1);
static int watchdog_fires;

static void test_watchdog_handler(void *context)
{
	int *fires = context;

	++*fires;
	k_sem_give(&watchdog_fired);
}

ZTEST(robot_control, test_watchdog_is_resettable_and_one_shot)
{
	struct resettable_watchdog watchdog;

	watchdog_fires = 0;
	k_sem_reset(&watchdog_fired);
	resettable_watchdog_init(&watchdog, test_watchdog_handler,
				 &watchdog_fires);

	resettable_watchdog_restart(&watchdog, 60U);
	k_msleep(30);
	resettable_watchdog_restart(&watchdog, 60U);
	zassert_equal(k_sem_take(&watchdog_fired, K_MSEC(40)), -EAGAIN,
		      "first deadline was not reset");
	zassert_equal(k_sem_take(&watchdog_fired, K_MSEC(80)), 0,
		      "reset deadline did not fire");
	zassert_equal(watchdog_fires, 1);

	k_msleep(80);
	zassert_equal(watchdog_fires, 1, "watchdog was periodic, not one-shot");
	resettable_watchdog_stop(&watchdog);
}

ZTEST(robot_control, test_config_receiver_acknowledges_every_chunk_and_applies)
{
	struct robot_runtime_config_v1 config = test_runtime_config();
	struct robot_runtime_config_v1 output = {0};
	struct robot_config_receiver receiver;
	struct robot_config_message_v1 message = {
		.magic = ROBOT_CONFIG_MESSAGE_MAGIC,
		.version = ROBOT_CONFIG_MESSAGE_VERSION,
		.type = ROBOT_CONFIG_BEGIN,
		.session_id = 7U,
		.chunk_count = (sizeof(config) + ROBOT_CONFIG_CHUNK_PAYLOAD_SIZE - 1U) /
			       ROBOT_CONFIG_CHUNK_PAYLOAD_SIZE,
		.config_size = sizeof(config),
		.config_crc32 = robot_config_crc32(&config, sizeof(config)),
	};
	struct robot_config_message_v1 response;
	bool applied = false;

	robot_config_receiver_init(&receiver);
	robot_config_receiver_handle(&receiver, &message, &response, &output,
				     &applied);
	zassert_equal(response.type, ROBOT_CONFIG_ACK);
	zassert_equal(response.chunk_count, 0U);
	zassert_false(applied);

	const uint8_t *bytes = (const uint8_t *)&config;
	for (uint16_t chunk = 0; chunk < message.chunk_count; ++chunk) {
		message.type = ROBOT_CONFIG_CHUNK;
		message.chunk_index = chunk;
		const size_t offset = (size_t)chunk * ROBOT_CONFIG_CHUNK_PAYLOAD_SIZE;
		message.payload_size = MIN(sizeof(config) - offset,
					   ROBOT_CONFIG_CHUNK_PAYLOAD_SIZE);
		memcpy(message.payload, bytes + offset, message.payload_size);
		robot_config_receiver_handle(&receiver, &message, &response, &output,
					     &applied);
		zassert_equal(response.type, ROBOT_CONFIG_ACK);
		zassert_equal(response.chunk_count, chunk + 1U);
		zassert_false(applied);
	}

	message.type = ROBOT_CONFIG_COMMIT;
	message.chunk_index = message.chunk_count;
	message.payload_size = 0U;
	robot_config_receiver_handle(&receiver, &message, &response, &output,
				     &applied);
	zassert_equal(response.type, ROBOT_CONFIG_APPLIED);
	zassert_true(applied);
	zassert_mem_equal(&output, &config, sizeof(config));
	zassert_true(receiver.receiving);
	zassert_equal(receiver.applied_session_id, 0U);

	/* Simulate controller rejection: the same COMMIT must remain retryable. */
	applied = false;
	robot_config_receiver_handle(&receiver, &message, &response, &output,
				     &applied);
	zassert_equal(response.type, ROBOT_CONFIG_APPLIED);
	zassert_true(applied);
	zassert_true(receiver.receiving);

	robot_config_receiver_mark_applied(&receiver);
	zassert_false(receiver.receiving);
	zassert_equal(receiver.applied_session_id, message.session_id);
	zassert_equal(receiver.applied_crc32, message.config_crc32);

	applied = false;
	robot_config_receiver_handle(&receiver, &message, &response, &output,
				     &applied);
	zassert_equal(response.type, ROBOT_CONFIG_APPLIED);
	zassert_false(applied);
}

ZTEST_SUITE(robot_control, NULL, NULL, NULL, NULL, NULL);
```
