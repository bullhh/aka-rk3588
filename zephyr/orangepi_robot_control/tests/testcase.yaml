## zephyr/orangepi_robot_control/tests/testcase.yaml
```yaml
tests:
  robot_control.timing:
    platform_allow:
      - native_sim/native/64
    tags:
      - robot
      - timing
      - watchdog
```
